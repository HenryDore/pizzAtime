/**************************************************************************
IT's MOTHERBLOODY PIZZATIME
Prototype of Crazy Pedros Full Time Pizza Timer
To Dos:
-Fix debounce, use elapsed Millis for this...
-Replace leading zeroes with sprintf? Not sure if faster
-Refactor time keeping to its own subroutine

**************************************************************************/

#include <Wire.h>             //I2C
#include <Adafruit_GFX.h>     //Graphics library
#include <Adafruit_SSD1306.h> //LCD screen driver
#include <elapsedMillis.h>    //non blocking timer for countdown

#define SCREEN_WIDTH 128 // OLED display width, in pixels
#define SCREEN_HEIGHT 64 // OLED display height, in pixels

#define OLED_RESET 4 // Reset pin # (or -1 if sharing Arduino reset pin)
#define SCREEN_ADDRESS 0x3C
Adafruit_SSD1306 display(SCREEN_WIDTH, SCREEN_HEIGHT, &Wire, OLED_RESET);

// 'word_pizza', 64x38px image of the word "pizza"
const unsigned char PROGMEM word_pizza[] = {
    0x00, 0x00, 0x00, 0x00, 0x00, 0x00, 0x00, 0x38, 0x70, 0x00, 0x00, 0x00, 0x00, 0xf0, 0x00, 0x7c,
    0xfe, 0x00, 0x00, 0x00, 0x00, 0xff, 0xf0, 0x7c, 0xff, 0x80, 0x00, 0x00, 0x00, 0xff, 0xf8, 0x7c,
    0xff, 0xf0, 0x00, 0x38, 0x18, 0xff, 0xfc, 0x7c, 0x7f, 0xf8, 0x0c, 0x7e, 0x3c, 0xff, 0xfc, 0x7c,
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    0x70, 0x01, 0x80, 0x00, 0x00, 0x00, 0x00, 0x38, 0x00, 0x00, 0x00, 0x00, 0x00, 0x00, 0x00, 0x10};

// 'pedro_BMP', 64x69px image of CRAZY PEDRO...
const unsigned char PROGMEM pedro_BMP[] = {
    0x00, 0x00, 0x01, 0xc0, 0x00, 0x00, 0x00, 0x00, 0x00, 0x00, 0x01, 0x30, 0x00, 0x00, 0x00, 0x00,
    0x00, 0x00, 0x02, 0x1f, 0x1f, 0xe0, 0x00, 0x00, 0x00, 0x00, 0x0e, 0x01, 0xf0, 0x1c, 0x00, 0x00,
    0x00, 0x00, 0x3c, 0x00, 0x00, 0x02, 0x00, 0x00, 0x00, 0x00, 0xe0, 0x00, 0x00, 0x01, 0xc0, 0x00,
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    0x00, 0x00, 0x00, 0x00, 0x00, 0x3e, 0x00, 0x00};

// 'pizza_BMP', 60x60px image of a pizza....
const unsigned char PROGMEM pizza_BMP[] = {
    0x00, 0x00, 0x00, 0x1f, 0x80, 0x00, 0x00, 0x00, 0x00, 0x00, 0x03, 0xff, 0xfc, 0x00, 0x00, 0x00,
    0x00, 0x00, 0x1f, 0x00, 0x0f, 0x80, 0x00, 0x00, 0x00, 0x00, 0x70, 0x00, 0x00, 0xe0, 0x00, 0x00,
    0x00, 0x01, 0xc0, 0x06, 0x00, 0x38, 0x00, 0x00, 0x00, 0x07, 0x01, 0xff, 0xf8, 0x0e, 0x00, 0x00,
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    0x00, 0x00, 0x03, 0xff, 0xfc, 0x00, 0x00, 0x00, 0x00, 0x00, 0x00, 0x1f, 0x80, 0x00, 0x00, 0x00};

//slice coordinates for drawing triangles
/*
uint16_t sC[8][6] = {
    {30, 29, 30, 0, 59, 0},
    {30, 29, 59, 0, 59, 29},
    {30, 30, 59, 30, 59, 59},
    {30, 30, 59, 59, 30, 59},
    {29, 30, 29, 59, 0, 59},
    {29, 30, 0, 59, 0, 30},
    {29, 29, 0, 29, 0, 0},
    {29, 29, 0, 0, 29, 0}};
*/
uint16_t sC[8][6] = {
    {32, 29, 32, 0, 61, 0},
    {32, 29, 61, 0, 61, 29},
    {32, 30, 61, 30, 61, 59},
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    {31, 29, 2, 0, 31, 0}};

elapsedMillis countdown_timer;
elapsedMillis button_debounce_timer;

int delay_speed = 50;
int countdown_remaining_time;
int L_buttonState = 0;
int M_buttonState = 0;
int R_buttonState = 0;
int system_state = 0;
bool state_initialised = 0;
int current_menu_option = 0; // 0 = select time, 1 = start
int debouce_millis = 250;
int countdown_target = 15;
int countdown_minutes;
int countdown_seconds;

const int L_ButtonPin = 7; // the number of the pushbutton pin
const int M_ButtonPin = 8; // the number of the pushbutton pin
const int R_ButtonPin = 9; // the number of the LED pin

void setup()
{
    pinMode(L_ButtonPin, INPUT);
    pinMode(R_ButtonPin, INPUT);
    //Serial.begin(9600);

    // SSD1306_SWITCHCAPVCC = generate display voltage from 3.3V internally
    if (!display.begin(SSD1306_SWITCHCAPVCC, SCREEN_ADDRESS))
    {
        //Serial.println(F("SSD1306 allocation failed"));
        for (;;)
            ; // Don't proceed, loop forever
    }
    display.setRotation(1);
    display.setTextColor(WHITE);
    display.setTextSize(2);

    //intro disable to speed up development...
    //displayIntro();

    system_state = 1; //loaded
}

void loop()
{
    get_button_states();

    if (system_state == 1)
    {
        system_state_1();
    }
    else if (system_state == 2)
    {
        system_state_2();
    }
    else if (system_state == 3)
    {
        system_state_3();
    }
    else
    {
        //do nothing
    }

    delay(10); //system refresh speed
}

void displayIntro()
{
    display.clearDisplay();
    display.drawBitmap(2, 0, pizza_BMP, 60, 60, 1);
    display.display();
    delay(500);

    for (int i = 0; i < 8; i++) //Black out all 8 pizza slices in order...
    {
        display.fillTriangle(sC[i][0], sC[i][1], sC[i][2], sC[i][3], sC[i][4], sC[i][5], BLACK);
        display.display();
        delay(delay_speed);
    }

    delay(500);

    display.drawBitmap(0, 0, pedro_BMP, 64, 69, 1);
    display.setTextColor(WHITE);
    display.setTextSize(2);

    for (int i = 0; i < 6; i++) //Flash the word PIZZA!
    {
        display.setCursor(4, 66);
        display.print("PIZZA");
        display.display();
        delay(50);
        display.fillRect(0, 65, 64, 15, BLACK);
        display.display();
        delay(50);
    }

    display.clearDisplay();
    display.display();
    delay(1000);
}

void system_state_1() //main menu
{
    if (state_initialised == 0)
    {
        display.setTextSize(1);
        display.clearDisplay();
        display.drawBitmap(0, 0, word_pizza, 64, 38, 1);
        display.display();
        state_initialised = 1;
    }
    else
    {
        //do nothing
    }

    if (M_buttonState == HIGH)
    {
        system_state = 3;
        state_initialised = 0;
    }
    if (L_buttonState == HIGH)
    {
        display.setCursor(4, 100);
        display.print("Left btn");
        display.display();
        display.fillRect(0, 65, 64, 128, BLACK);
        display.display();
    }
    if (R_buttonState == HIGH)
    {
        display.setCursor(4, 100);
        display.print("Right btn");
        display.display();
        display.fillRect(0, 65, 64, 128, BLACK);
        display.display();
    }
}

void system_state_2() //select time
{
    if (state_initialised == 0)
    {
        state_initialised = 1;
    }
    else
    {
        //do nothing
    }

    if (L_buttonState == HIGH)
    {
    }
    if (R_buttonState == HIGH)
    {
    }
}

void system_state_3() //counting down
{
    if (state_initialised == 0)
    {
        display.clearDisplay();
        display.setTextSize(2);
        display.setCursor(4, 64);
        countdown_minutes = countdown_target / 60;
        countdown_seconds = countdown_target % 60;
        if (countdown_minutes < 10)
        {
            display.print("0");
        }
        display.print(countdown_minutes);
        display.print(":");
        if (countdown_seconds < 10)
        {
            display.print("0");
        }
        display.print(countdown_seconds);
        display.drawBitmap(2, 0, pizza_BMP, 60, 60, 1);
        display.display();
        for (int i = 0; i < 8; i++) //Black out all 8 pizza slices in order...
        {
            display.fillTriangle(sC[i][0], sC[i][1], sC[i][2], sC[i][3], sC[i][4], sC[i][5], BLACK);
            display.display();
            delay(25);
        }
        display.drawBitmap(2, 0, pizza_BMP, 60, 60, 1);
        display.display();
        state_initialised = 1;
        L_buttonState = false;
        countdown_timer = 0;
    }
    else
    {
        //do nothing
    }

    countdown_remaining_time = (countdown_target)-countdown_timer / 1000;
    if (countdown_remaining_time < 0)
    {
        displayIntro();
        displayIntro();
        countdown_target = 6000;
        system_state = 1; //loaded
        state_initialised = 0;
    }
    else
    {
        countdown_minutes = countdown_remaining_time / 60;
        countdown_seconds = countdown_remaining_time % 60;
        display.fillRect(0, 64, 64, 94, BLACK);
        display.setCursor(4, 64);
        if (countdown_minutes < 10)
        {
            display.print("0");
        }
        display.print(countdown_minutes);
        display.print(":");
        if (countdown_seconds < 10)
        {
            display.print("0");
        }
        display.print(countdown_seconds);
        display.display();

        if (M_buttonState == HIGH)
        {
            system_state = 1;
            state_initialised = 0;
        }
        if (L_buttonState == HIGH)
        {
            countdown_target = countdown_target - 60;
        }
        if (R_buttonState == HIGH)
        {
            countdown_target = countdown_target + 60;
        }
    }
}

void get_button_states()
{
    if (button_debounce_timer > 500)
    {
        L_buttonState = digitalRead(L_ButtonPin);
        M_buttonState = digitalRead(M_ButtonPin);
        R_buttonState = digitalRead(R_ButtonPin);

        if (L_buttonState == true || M_buttonState == true || R_buttonState == true)
        {
            button_debounce_timer = 0;
        }
    }
    else
    {
        L_buttonState = false;
        M_buttonState = false;
        R_buttonState = false;
    }
}